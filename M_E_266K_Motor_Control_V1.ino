/*
 * M E 266K Motor Control
 * 
 * This sketch is the control system for Roberto Dailey, Austin Vojta, Keith Shannon, and
 * Joshua Smith's 4-axis light reflectance measurement device. 
 * 
 * Arduino should receive commands from PC, and respond appropriately by adjusting light
 * control and position control
 *
 */
#include <Arduino.h>
#include "BasicStepperDriver.h"
#include "MultiDriver.h"
#include "SyncDriver.h"

// Motor steps per revolution. Most steppers are 200 steps or 1.8 degrees/step
#define MOTOR_STEPS 200

// Target RPM for Ring motor
#define MOTOR_R_RPM 90
// Gear Ratio for Ring motor
#define RGR 30

// Target RPM for Emitter motor
#define MOTOR_E_RPM 105
// Gear Ratio for Emitter motor
#define EGR 35

// Target RPM for Sensor motor
#define MOTOR_S_RPM 72
// Gear Ratio for Sensor motor
#define SGR 24

// Target RPM for Table motor
#define MOTOR_T_RPM 37.5
// Gear Ratio for Table motor
#define TGR 12.5

// Ring motor
#define DIR_R 22
#define STEP_R 23

// Emitter motor
#define DIR_E 24
#define STEP_E 25

// Sensor motor
#define DIR_S 26
#define STEP_S 27

//  Table motor
#define DIR_T 28
#define STEP_T 29


// If microstepping is set externally, make sure this matches the selected mode
// 1=full step, 2=half step etc.
#define MICROSTEPS 1

// 2-wire basic config, microstepping is hardwired on the driver
// Other drivers can be mixed and matched but must be configured individually
BasicStepperDriver stepperR(MOTOR_STEPS, DIR_R, STEP_R);
BasicStepperDriver stepperE(MOTOR_STEPS, DIR_E, STEP_E);
BasicStepperDriver stepperS(MOTOR_STEPS, DIR_S, STEP_S);
BasicStepperDriver stepperT(MOTOR_STEPS, DIR_T, STEP_T);

// each motor moves independently, trajectory is a hockey stick
  MultiDriver controller(stepperR, stepperS, stepperT);


// Current position of each angular axis. System starts “homed”
float RCpos = 0;
float ECpos = 0;
float SCpos = 0;
float TCpos = 0;

//  variables to calculate movement for each axis, relative to current position
float Rmove = 0;
float Emove = 0;
float Smove = 0;
float Tmove = 0;

String incoming;
String previous;

// Comma indexes for string parsing
int CI1 = 0;
int CI2 = 0;
int CI3 = 0;
int CI4 = 0;
int CI5 = 0;

// Pins for LED controls
int redPin = 11;
int greenPin = 10;
int bluePin = 9;

void setup() {
    Serial.begin(9600);
    
    // Set target motors RPM
    stepperR.begin(MOTOR_R_RPM, MICROSTEPS);
    stepperE.begin(MOTOR_E_RPM, MICROSTEPS);
    stepperS.begin(MOTOR_S_RPM, MICROSTEPS);
    stepperT.begin(MOTOR_T_RPM, MICROSTEPS);
    
    // initialize pins for LEDs
    pinMode(redPin, OUTPUT);
    pinMode(greenPin, OUTPUT);
    pinMode(bluePin, OUTPUT);
}

void loop() {
    // only run commands while serial connection is available
  if (Serial.available() > 0) {
    incoming=Serial.readString()+',';
    
    delay(100);
     if (incoming != "" || incoming != previous) { 
       
       // parse string
       CI1=incoming.indexOf(',');
       String command=incoming.substring(0,CI1);
       
       if (command == 'A') {
         // get indexes of commas from recieved string
         CI2=incoming.indexOf(',', CI1+1);
         CI3=incoming.indexOf(',', CI2+1);
         CI4=incoming.indexOf(',', CI3+1);
         CI5=incoming.indexOf(',', CI4+1);
         
         // separate into substrings
         String str2 = incoming.substring(CI1+1, CI2);
         String str3 = incoming.substring(CI2+1, CI3);
         String str4 = incoming.substring(CI3+1, CI4);
         String str5 = incoming.substring(CI4+1, CI5);
         
         // correct angular position vectors
         float Rpos = str2.toFloat();
         float Epos = str3.toFloat();
         float Spos = str4.toFloat();
         float Tpos = str5.toFloat();
         
         // create movement vectors
         // adjusted for gear ratios (angular differences multiplied by the gear ratio)
         float Rmove = (Rpos - RCpos)*RGR;
         float Emove = (Epos - ECpos)*EGR;
         float Smove = (Spos - SCpos)*SGR;
         float Tmove = (Tpos - TCpos)*TGR;
         
          // move motors in absolute positions
         controller.rotate(Rmove, Smove, Tmove);
         delay(100);
         
         stepperE.rotate(Emove);
         delay(100);
         
         RCpos = Rpos;
         ECpos = Epos;
         SCpos = Spos;
         TCpos = Tpos;
         
         String printString = ',' + String(RCpos)+ ',' + String(ECpos) + ',' + String(SCpos) + ',' + String(TCpos);
         //String printString = "I am here";
         Serial.print('A');
         Serial.print(printString);
         Serial.print("\t");
        }
        
        
       else if (command == 'R') {
         // get indexes of commas from recieved string
         CI2=incoming.indexOf(',', CI1+1);
         CI3=incoming.indexOf(',', CI2+1);
         CI4=incoming.indexOf(',', CI3+1);
         CI5=incoming.indexOf(',', CI4+1);
         
         // separate into substrings
         String str2 = incoming.substring(CI1+1, CI2);
         String str3 = incoming.substring(CI2+1, CI3);
         String str4 = incoming.substring(CI3+1, CI4);
         String str5 = incoming.substring(CI4+1, CI5);
         
         // correct angular position vectors
         float Rpos = str2.toFloat();
         float Epos = str3.toFloat();
         float Spos = str4.toFloat();
         float Tpos = str5.toFloat();
         
         // create movement vectors
         // adjusted for gear ratios (angular differences multiplied by the gear ratio)
         float Rmove = (Rpos)*RGR;
         float Emove = (Epos)*EGR;
         float Smove = (Spos)*SGR;
         float Tmove = (Tpos)*TGR;
         
         // move motors in relative position and rezero
         controller.rotate(Rmove,Smove,Tmove);
         delay(100);
          
         stepperE.rotate(Emove);
         delay(100);
         
         RCpos = 0;
         ECpos = 0;
         SCpos = 0;
         TCpos = 0;
         
         String printString =',' + String(RCpos) + ',' + String(ECpos) + ',' + String(SCpos) + ',' + String(TCpos);
         //String printString ="I am homed";
         Serial.print('R');
         Serial.print(printString);
         Serial.print("\t");
        }
        
        else if (command == 'ON') {
          CI2=incoming.indexOf(',', CI1+1);
          CI3=incoming.indexOf(',', CI2+1);
          CI4=incoming.indexOf(',', CI3+1);
          
          // separate into substrings
          String str2 = incoming.substring(CI1+1, CI2);
          String str3 = incoming.substring(CI2+1, CI3);
          String str4 = incoming.substring(CI3+1, CI4);
         
          // analog write values
          int r = str2.toInt();
          int g = str3.toInt();
          int b = str4.toInt();
          
          
          analogWrite(redPin, r);
          analogWrite(greenPin, g);
          analogWrite(bluePin, b);
        }
        
        else if (command == 'OFF'){
          analogWrite(redPin, 0);
          analogWrite(greenPin, 0);
          analogWrite(bluePin, 0);
        }
     previous = incoming;
     incoming = "";
    }
  }
}
